## boards/shields/scobc_module1_a1/Kconfig.defconfig
```kconfig
# SC OBC Module 1 A1 shield

# Copyright (c) 2023 Space Cubics,LLC
# SPDX-License-Identifier: Apache-2.0

if SHIELD_SCOBC_MODULE1_A1

config CPU_CORTEX_M_HAS_SYSTICK
	default y

config CPU_HAS_ARM_MPU
	default y

config NUM_IRQS
	default 32

endif # SHIELD_SCOBC_MODULE1_A1
```

## boards/shields/scobc_module1_a1/Kconfig.shield
```kconfig
# Copyright (c) 2025 Space Cubics, LLC.
# SPDX-License-Identifier: Apache-2.0

config SHIELD_SCOBC_MODULE1_A1
	bool "OBC Module 1 A1 shield"
```
